## boards/gumulka/ble_door_sensor/Kconfig.defconfig
```kconfig
if BOARD_EPAPER_NAMETAG

config BOARD
	default "epaper_nametag"

config BT_CTLR
	default BT

endif # BOARD_EPAPER_NAMETAG
```

## boards/gumulka/ble_door_sensor/Kconfig.epaper_nametag
```kconfig
config BOARD_EPAPER_NAMETAG
	bool "BLE e-Paper Nametag"
	select SOC_NRF52832_QFAA
```

## boards/gumulka/ble_door_sensor/board.yml
```yaml
# Copyright (c) 2024 Nordic Semiconductor ASA
# SPDX-License-Identifier: Apache-2.0

board:
  name: epaper_nametag
  vendor: gumulka
  socs:
    - name: nrf52832
```
