## prj.conf
```kconfig
CONFIG_BOOT_BANNER_STRING="ePaper Nametag - build"

# enable GPIO
CONFIG_GPIO=y

# enable ADC
CONFIG_ADC=y

# enable power management
CONFIG_PM_DEVICE=y
CONFIG_PM_DEVICE_RUNTIME=y

CONFIG_DISPLAY=y
CONFIG_CHARACTER_FRAMEBUFFER=y
CONFIG_HEAP_MEM_POOL_SIZE=16384
CONFIG_NRF52_ANOMALY_89_WORKAROUND=y
```

## debug.conf
```kconfig
# compiler
CONFIG_DEBUG_OPTIMIZATIONS=y

# console
CONFIG_CONSOLE=y

# UART console
CONFIG_SERIAL=y
CONFIG_UART_CONSOLE=y

# logging
CONFIG_LOG=y
CONFIG_APP_LOG_LEVEL_DBG=y

CONFIG_CHARACTER_FRAMEBUFFER_SHELL=y
CONFIG_SHELL=y
CONFIG_GPIO_SHELL=y
```

## src/main.c
```c
#include <zephyr/kernel.h>
#include <zephyr/drivers/gpio.h>
#include <zephyr/display/cfb.h>

#include "nametag.h"

#include <zephyr/logging/log.h>
LOG_MODULE_REGISTER(main, CONFIG_APP_LOG_LEVEL);

static const struct gpio_dt_spec led = GPIO_DT_SPEC_GET(DT_ALIAS(led0), gpios);
static const struct gpio_dt_spec button = GPIO_DT_SPEC_GET_OR(DT_ALIAS(sw0), gpios, {0});
static struct gpio_callback button_cb_data;

static const struct device *const display = DEVICE_DT_GET(DT_CHOSEN(zephyr_display));
static const struct gpio_dt_spec enable = GPIO_DT_SPEC_GET(DT_PATH(zephyr_user), enable_gpios);

static int current_image = 0;

typedef int (*image_display)(const struct device *const display);

image_display images[] = {
	serious_name, serious_nick,     serious_full_name,
	lgbtq_name,   lgbtq_name_extra, fabilicious_turtli,
};

static void set_display(struct k_work *_work)
{
	gpio_pin_set_dt(&enable, 1);
	clear_display(display);
	if (current_image < ARRAY_SIZE(images) && images[current_image]) {
		images[current_image](display);
	} else {
		current_image = -1;
	}
	gpio_pin_set_dt(&enable, 0);
}
K_WORK_DELAYABLE_DEFINE(set_display_work, set_display);

void button_pressed(const struct device *dev, struct gpio_callback *cb, uint32_t pins)
{
	printk("Button pressed at %" PRIu32 "\n", k_cycle_get_32());
	current_image++;
	k_work_reschedule(&set_display_work, K_MSEC(1000));
}

int main(void)
{
	int ret;

	if (!gpio_is_ready_dt(&led)) {
		LOG_ERR("No LED defined");
		return -ENODEV;
	}

	ret = gpio_pin_configure_dt(&led, GPIO_OUTPUT_INACTIVE);
	if (ret < 0) {
		LOG_ERR("Could not configure LED.");
		return 0;
	}

	if (!gpio_is_ready_dt(&enable)) {
		LOG_ERR("Could not configure enable pin for display");
		return -ENODEV;
	}

	(void)gpio_pin_configure_dt(&enable, GPIO_OUTPUT_INACTIVE);

	if (!device_is_ready(display)) {
		LOG_WRN("Display device not ready");
		return -ENODEV;
	}

	ret = cfb_framebuffer_init(display);
	if (ret) {
		LOG_WRN("Framebuffer initialization failed!");
		return ret;
	}

	if (!gpio_is_ready_dt(&button)) {
		printk("Error: button device %s is not ready\n", button.port->name);
		return -ENODEV;
	}

	ret = gpio_pin_configure_dt(&button, GPIO_INPUT);
	if (ret != 0) {
		printk("Error %d: failed to configure %s pin %d\n", ret, button.port->name,
		       button.pin);
		return 0;
	}

	ret = gpio_pin_interrupt_configure_dt(&button, GPIO_INT_EDGE_TO_ACTIVE);
	if (ret != 0) {
		printk("Error %d: failed to configure interrupt on %s pin %d\n", ret,
		       button.port->name, button.pin);
		return 0;
	}

	gpio_init_callback(&button_cb_data, button_pressed, BIT(button.pin));
	gpio_add_callback(button.port, &button_cb_data);

	k_work_reschedule(&set_display_work, K_MSEC(1000));

	return 0;
}
```

## src/helper.c
```c
#include "nametag.h"

#include <zephyr/display/cfb.h>

#include <zephyr/logging/log.h>
LOG_MODULE_REGISTER(helper, CONFIG_APP_LOG_LEVEL);

int clear_display(const struct device *const display)
{
	int err;
	display_blanking_on(display);

	err = cfb_framebuffer_clear(display, true);
	if (err) {
		LOG_WRN("Framebuffer clear error=%d", err);
		return err;
	}
	return display_blanking_off(display);
}
```

## src/image.c
```c
#include <zephyr/display/cfb.h>

int draw_pixel(const struct device *const display, int x, int y, int factor)
{
	struct cfb_position pixel;
	for (int i_x = 0; i_x < factor; i_x++) {
		for (int i_y = 0; i_y < factor; i_y++) {
			pixel.x = x + i_x;
			pixel.y = y + i_y;
			cfb_draw_point(display, &pixel);
		}
	}
	return 0;
}

int draw_image(const struct device *const display, int x_pos, int y_pos, int width, int height,
	       int factor, char *data)
{
	int width_offset = (width + 7) / 8;
	width_offset *= 8;
	for (int x = 0; x < width; x++) {
		for (int y = 0; y < height; y++) {

			int pos = y * width_offset + x;
			int bit = pos % 8;
			pos /= 8;
			if (data[pos] >> bit & 1) {
				draw_pixel(display, x * factor + x_pos, y * factor + y_pos, factor);
			}
		}
	}
	return 0;
}
```

## src/image.h
```c
#include <zephyr/kernel.h>

int draw_pixel(const struct device *const display, int x, int y, int factor);

int draw_image(const struct device *const display, int x_pos, int y_pos, int width, int height,
	       int factor, char *data);
```

## src/lgbtq_name.c
```c
#include "nametag.h"

#include <zephyr/display/cfb.h>

#include <zephyr/logging/log.h>
LOG_MODULE_REGISTER(lgbtq_name, CONFIG_APP_LOG_LEVEL);

int lgbtq_name_display(const struct device *const display, bool with_umarmungen)
{
	int err;
	int y_pos = 10;

	err = cfb_set_kerning(display, 0);
	if (err) {
		return err;
	}
	err = cfb_framebuffer_set_font(display, 2);
	if (err) {
		return err;
	}
	if (!with_umarmungen) {
		y_pos += 10;
	}
	err = cfb_draw_text(display, "Fabian Pflug", 25, y_pos);
	if (err) {
		return err;
	}

	err = cfb_framebuffer_set_font(display, 1);
	if (err) {
		return err;
	}
	y_pos += 35;
	err = cfb_draw_text(display, "er/ihm", 110, y_pos);
	if (err) {
		return err;
	}

	err = cfb_framebuffer_set_font(display, 0);
	if (err) {
		return err;
	}
	err = cfb_set_kerning(display, 4);
	if (err) {
		return err;
	}

	y_pos += 35;
	if (!with_umarmungen) {
		y_pos += 10;
	}
	err = cfb_draw_text(display, "Kinky/Poly/Allo-Aro", 15, y_pos);
	if (err) {
		return err;
	}

	if (with_umarmungen) {
		y_pos += 30;
		err = cfb_draw_text(display, "Ich liebe Umarmungen", 10, y_pos);
		if (err) {
			return err;
		}
	}

	err = cfb_framebuffer_finalize(display);
	if (err) {
		return err;
	}

	return 0;
}

int lgbtq_name(const struct device *const display)
{
	return lgbtq_name_display(display, false);
}

int lgbtq_name_extra(const struct device *const display)
{
	return lgbtq_name_display(display, true);
}
```

## src/nametag.h
```c
#include <zephyr/kernel.h>

int clear_display(const struct device *const display);

int serious_name(const struct device *const display);
int serious_nick(const struct device *const display);
int serious_full_name(const struct device *const display);

int lgbtq_name(const struct device *const display);
int lgbtq_name_extra(const struct device *const display);

int fabilicious_turtli(const struct device *const display);
```

## src/serious_name.c
```c
#include "nametag.h"

#include <zephyr/display/cfb.h>

#include <zephyr/logging/log.h>
LOG_MODULE_REGISTER(serious_name, CONFIG_APP_LOG_LEVEL);

static int serious_name_show(const struct device *const display, char *name)
{
	int err;

	uint8_t width, heigth;

	err = cfb_set_kerning(display, 0);
	if (err) {
		return err;
	}
	err = cfb_framebuffer_set_font(display, 2);
	if (err) {
		return err;
	}
	cfb_get_font_size(display, 2, &width, &heigth);
	int num_chr = strlen(name);
	int position = (296 - num_chr * width) / 2;

	err = cfb_draw_text(display, name, position, 40);
	if (err) {
		return err;
	}
	err = cfb_framebuffer_set_font(display, 1);
	if (err) {
		return err;
	}
	err = cfb_draw_text(display, "er/ihm", 110, 70);
	if (err) {
		return err;
	}

	err = cfb_framebuffer_finalize(display);
	if (err) {
		return err;
	}

	return 0;
}

int serious_name(const struct device *const display)
{
	return serious_name_show(display, "Fabian");
}

int serious_nick(const struct device *const display)
{
	return serious_name_show(display, "Fabian/Gumulka");
}

int serious_full_name(const struct device *const display)
{
	return serious_name_show(display, "Fabian Pflug");
}
```

## src/turtli.c
```c
#include "nametag.h"
#include "image.h"
#include <zephyr/display/cfb.h>

#define turtli_width  43
#define turtli_height 19

static char turtli_black_bits[] = {
	0x00, 0x00, 0xf8, 0x3f, 0x00, 0x00, 0x00, 0x00, 0x27, 0xe8, 0x01, 0x00, 0x00, 0xe0, 0x14,
	0x10, 0x03, 0x00, 0xf8, 0x11, 0x3c, 0xf0, 0x0e, 0x00, 0x04, 0x2e, 0xc2, 0x1f, 0x19, 0x00,
	0x22, 0x64, 0x81, 0x20, 0x36, 0x00, 0x21, 0x98, 0x83, 0xc0, 0xe9, 0x01, 0x03, 0x32, 0x9d,
	0x38, 0x11, 0x06, 0xfc, 0xc7, 0xe8, 0x27, 0x1e, 0x04, 0x00, 0x9c, 0x47, 0xc4, 0x0f, 0x02,
	0x00, 0x38, 0x5c, 0x74, 0xf8, 0x01, 0x00, 0x48, 0xe8, 0xdf, 0x08, 0x00, 0x00, 0x48, 0x70,
	0x00, 0x0f, 0x00, 0x00, 0x98, 0xc0, 0x00, 0x00, 0x00, 0x00, 0x90, 0x80, 0x01, 0x00, 0x00,
	0x00, 0x30, 0x03, 0x03, 0x00, 0x00, 0x00, 0xa0, 0x04, 0x06, 0x00, 0x00, 0x00, 0xe0, 0x18,
	0x04, 0x00, 0x00, 0x00, 0x00, 0xe0, 0x07, 0x00, 0x00};
static char turtli_dark_grey_bits[] = {
	0x00, 0x00, 0x00, 0x00, 0x00, 0x00, 0x00, 0x00, 0xd8, 0x17, 0x00, 0x00, 0x00, 0x00, 0xeb,
	0xef, 0x00, 0x00, 0x00, 0xe0, 0xc3, 0x0f, 0x01, 0x00, 0x00, 0xd0, 0x3d, 0xe0, 0x06, 0x00,
	0x00, 0x98, 0x7e, 0xdf, 0x09, 0x00, 0x00, 0x60, 0x7c, 0x3f, 0x16, 0x00, 0x00, 0xc0, 0x62,
	0xc7, 0x0e, 0x00, 0x00, 0x00, 0x17, 0xd8, 0x01, 0x00, 0x00, 0x00, 0xb8, 0x3b, 0x00, 0x00,
	0x00, 0x00, 0xa0, 0x0b, 0x00, 0x00, 0x00, 0x00, 0x00, 0x00, 0x00, 0x00, 0x00, 0x00, 0x00,
	0x00, 0x00, 0x00, 0x00, 0x00, 0x00, 0x00, 0x00, 0x00, 0x00, 0x00, 0x00, 0x00, 0x00, 0x00,
	0x00, 0x00, 0x00, 0x00, 0x00, 0x00, 0x00, 0x00, 0x00, 0x00, 0x00, 0x00, 0x00, 0x00, 0x00,
	0x00, 0x00, 0x00, 0x00, 0x00, 0x00, 0x00, 0x00, 0x00};
static char turtli_light_grey_bits[] = {
	0x00, 0x00, 0x00, 0x00, 0x00, 0x00, 0x00, 0x00, 0x00, 0x00, 0x00, 0x00, 0x00, 0x00, 0x00,
	0x00, 0x00, 0x00, 0x00, 0x00, 0x00, 0x00, 0x00, 0x00, 0xf8, 0x01, 0x00, 0x00, 0x00, 0x00,
	0xdc, 0x03, 0x00, 0x00, 0x00, 0x00, 0xde, 0x07, 0x00, 0x00, 0x00, 0x00, 0xfc, 0x0d, 0x00,
	0x00, 0xe0, 0x01, 0x00, 0x38, 0x00, 0x00, 0xe0, 0x03, 0x00, 0x60, 0x00, 0x00, 0xf0, 0x01,
	0x00, 0xc0, 0x03, 0x80, 0x07, 0x00, 0x00, 0xb0, 0x07, 0x00, 0x07, 0x00, 0x00, 0xb0, 0x0f,
	0x00, 0x00, 0x00, 0x00, 0x60, 0x3f, 0x00, 0x00, 0x00, 0x00, 0x60, 0x7f, 0x00, 0x00, 0x00,
	0x00, 0xc0, 0xfc, 0x00, 0x00, 0x00, 0x00, 0x40, 0xf8, 0x01, 0x00, 0x00, 0x00, 0x00, 0xe0,
	0x03, 0x00, 0x00, 0x00, 0x00, 0x00, 0x00, 0x00, 0x00};

#define TURTLI_POS_X  150
#define TURTLI_POS_Y  50
#define TURTLY_FACTOR 3

#define tortoise_width  96
#define tortoise_height 50
static unsigned char tortoise_bits[] = {
	0x00, 0x00, 0x00, 0x00, 0x00, 0x00, 0x80, 0x07, 0x00, 0x00, 0x00, 0x00, 0x00, 0x00, 0x00,
	0x00, 0x00, 0x00, 0xf8, 0x7f, 0x00, 0x00, 0x00, 0x00, 0x00, 0x00, 0x00, 0x00, 0x00, 0x80,
	0xff, 0xff, 0x0f, 0x00, 0x00, 0x00, 0x00, 0x00, 0x00, 0x00, 0x00, 0xf0, 0xff, 0xfc, 0x3f,
	0x00, 0x00, 0x00, 0x00, 0x00, 0x00, 0x00, 0x00, 0xfc, 0x0f, 0xe0, 0xff, 0x00, 0x00, 0x00,
	0x00, 0x00, 0x00, 0x00, 0x00, 0xfe, 0x0f, 0xc0, 0xf9, 0x03, 0x00, 0x00, 0x00, 0x00, 0x00,
	0x00, 0x00, 0x1f, 0x0e, 0xc0, 0xe1, 0x07, 0x00, 0x00, 0x00, 0xf8, 0x00, 0x00, 0x80, 0x0f,
	0x0e, 0xc0, 0x81, 0x0f, 0x00, 0x00, 0x00, 0xff, 0x07, 0x00, 0xc0, 0x03, 0x0f, 0xc0, 0x01,
	0x1f, 0x00, 0x00, 0xc0, 0xff, 0x1f, 0x00, 0xe0, 0x01, 0x0f, 0xc0, 0x01, 0x3e, 0x00, 0x00,
	0xf0, 0xcf, 0x3f, 0x00, 0xf0, 0x03, 0x07, 0xc0, 0x01, 0x7f, 0x00, 0x00, 0xf8, 0x01, 0x7c,
	0x00, 0xf8, 0x07, 0x07, 0xc0, 0x81, 0xff, 0x00, 0x00, 0x78, 0x00, 0xf0, 0x00, 0xf8, 0xff,
	0x07, 0xc0, 0xff, 0xf7, 0x01, 0x00, 0x3c, 0x78, 0xe0, 0x01, 0x3c, 0xff, 0xe7, 0xcf, 0xff,
	0xe3, 0x01, 0x00, 0x1e, 0x78, 0xc0, 0x03, 0x1e, 0xff, 0xff, 0xff, 0xff, 0xc1, 0x03, 0x00,
	0x1e, 0x30, 0x80, 0x03, 0x0e, 0x87, 0xff, 0xff, 0xc3, 0x81, 0x07, 0x00, 0x1f, 0x00, 0x80,
	0x07, 0x0f, 0x07, 0x7c, 0x7c, 0x80, 0x83, 0x07, 0x00, 0x1f, 0x00, 0x00, 0x87, 0x87, 0x07,
	0x1c, 0x70, 0x80, 0x03, 0x0f, 0x00, 0x1f, 0x00, 0x00, 0x8f, 0x83, 0x03, 0x1c, 0xf0, 0x80,
	0x07, 0x0e, 0x00, 0x3e, 0x0c, 0x00, 0xfe, 0xc3, 0x03, 0x1c, 0xe0, 0x00, 0x07, 0x1e, 0x00,
	0xfe, 0x0f, 0x00, 0xfc, 0xc3, 0x01, 0x1c, 0xe0, 0x00, 0x0f, 0x1c, 0x00, 0xf8, 0x07, 0x00,
	0xfc, 0xc7, 0x01, 0x1c, 0xe0, 0x00, 0x0e, 0x3c, 0x00, 0xf0, 0x00, 0x00, 0xf0, 0xff, 0x01,
	0x1e, 0xe0, 0x00, 0x0e, 0x7f, 0x00, 0xf0, 0x03, 0x00, 0xe0, 0xff, 0x00, 0x0e, 0xe0, 0x00,
	0xfe, 0xff, 0x00, 0xe0, 0xff, 0x07, 0xe0, 0xfc, 0x03, 0x0e, 0xe0, 0x80, 0xff, 0xff, 0x00,
	0x80, 0xff, 0x3f, 0xe0, 0xf0, 0x7f, 0x0e, 0xe0, 0xff, 0xff, 0xe1, 0x01, 0x00, 0xfe, 0xff,
	0xe0, 0xc1, 0xff, 0xff, 0xff, 0xff, 0x1f, 0xc0, 0x01, 0x00, 0x00, 0xfc, 0xc1, 0x01, 0xfe,
	0xff, 0xff, 0xff, 0x00, 0xc0, 0x03, 0x00, 0x00, 0xe0, 0xc7, 0x03, 0xe0, 0xff, 0xff, 0x03,
	0x00, 0xe0, 0x03, 0x00, 0x00, 0xc0, 0xff, 0x0f, 0x00, 0x00, 0x00, 0x00, 0x00, 0xfc, 0x03,
	0x00, 0x00, 0x00, 0xff, 0x1f, 0x00, 0x00, 0x00, 0x00, 0xe0, 0xff, 0x07, 0x00, 0x00, 0x00,
	0xfc, 0xff, 0x00, 0x00, 0x00, 0x80, 0xff, 0xff, 0x1f, 0x00, 0x00, 0x00, 0x70, 0xfc, 0x1f,
	0x00, 0x80, 0xff, 0xff, 0x07, 0x3f, 0x00, 0x00, 0x00, 0x78, 0xf0, 0xff, 0xff, 0xff, 0xff,
	0xff, 0x0f, 0x7c, 0x00, 0x00, 0x00, 0x38, 0xe0, 0xff, 0xff, 0xff, 0xff, 0x81, 0x3f, 0xf0,
	0x00, 0x00, 0x00, 0x38, 0xe0, 0xf1, 0xff, 0xff, 0xe1, 0x81, 0xff, 0xf1, 0x00, 0x00, 0x00,
	0x78, 0xe0, 0x01, 0x00, 0x00, 0xe0, 0x81, 0xff, 0x7f, 0x00, 0x00, 0x00, 0x70, 0xe0, 0x07,
	0x00, 0x00, 0xe0, 0x03, 0xef, 0x7f, 0x00, 0x00, 0x00, 0xf0, 0xe0, 0xff, 0x07, 0xf8, 0xff,
	0x0f, 0x0f, 0x1f, 0x00, 0x00, 0x00, 0xf0, 0xe0, 0xff, 0x1f, 0xfc, 0xff, 0x1f, 0x1e, 0x00,
	0x00, 0x00, 0x00, 0xe0, 0xe0, 0xf8, 0xff, 0xff, 0x3f, 0x1e, 0x1c, 0x00, 0x00, 0x00, 0x00,
	0xf0, 0xe0, 0x00, 0xfc, 0x1f, 0x00, 0x1f, 0x1c, 0x00, 0x00, 0x00, 0x00, 0x78, 0xc0, 0x01,
	0xf0, 0x07, 0x80, 0x0f, 0x1c, 0x00, 0x00, 0x00, 0x00, 0x3c, 0xc0, 0x01, 0x00, 0x00, 0xc0,
	0x07, 0x1c, 0x00, 0x00, 0x00, 0x00, 0x1c, 0xe0, 0x01, 0x00, 0x00, 0xc0, 0x01, 0x1c, 0x00,
	0x00, 0x00, 0x00, 0x1c, 0xf0, 0x00, 0x00, 0x00, 0xc0, 0x01, 0x1e, 0x00, 0x00, 0x00, 0x00,
	0x3c, 0xf8, 0x00, 0x00, 0x00, 0xc0, 0x83, 0x0f, 0x00, 0x00, 0x00, 0x00, 0xfc, 0x7f, 0x00,
	0x00, 0x00, 0x80, 0xcf, 0x07, 0x00, 0x00, 0x00, 0x00, 0xf8, 0x3f, 0x00, 0x00, 0x00, 0x80,
	0xff, 0x07, 0x00, 0x00, 0x00, 0x00, 0x80, 0x0f, 0x00, 0x00, 0x00, 0x00, 0x7f, 0x00, 0x00};

int fabilicious_turtli(const struct device *const display)
{
	int err;
	draw_image(display, TURTLI_POS_X, TURTLI_POS_Y, turtli_width, turtli_height, TURTLY_FACTOR,
		   turtli_light_grey_bits);
	cfb_framebuffer_finalize(display);
	err = cfb_framebuffer_clear(display, true);
	err = cfb_framebuffer_clear(display, true);
	draw_image(display, TURTLI_POS_X, TURTLI_POS_Y, turtli_width, turtli_height, TURTLY_FACTOR,
		   turtli_dark_grey_bits);
	cfb_framebuffer_finalize(display);
	err = cfb_framebuffer_clear(display, true);
	err = cfb_framebuffer_clear(display, true);
	draw_image(display, TURTLI_POS_X, TURTLI_POS_Y, turtli_width, turtli_height, TURTLY_FACTOR,
		   turtli_black_bits);
	cfb_set_kerning(display, 0);
	cfb_framebuffer_set_font(display, 2);
	cfb_draw_text(display, "Fabilicious", 25, 10);
	cfb_framebuffer_set_font(display, 1);
	cfb_draw_text(display, "Ich mag", 25, 55);
	cfb_draw_text(display, "kuscheln", 25, 80);
	cfb_framebuffer_finalize(display);
	return err;
}
```
